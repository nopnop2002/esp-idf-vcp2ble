## sdkconfig.defaults
```kconfig
# Override some defaults so BT stack is enabled
CONFIG_COMPILER_CXX_EXCEPTIONS=y
CONFIG_USB_HOST_HUBS_SUPPORTED=y

#
# Bluetooth
#
CONFIG_BT_ENABLED=y
CONFIG_BT_BLUEDROID_ENABLED=n
CONFIG_BT_NIMBLE_ENABLED=y

#
# Controller Options
#
#CONFIG_BTDM_CTRL_MODE_BLE_ONLY=y
#CONFIG_BTDM_CTRL_MODE_BR_EDR_ONLY=n
#CONFIG_BTDM_CTRL_MODE_BTDM=n
```
